## drivers/infiniband/hw/irdma/Kconfig
```kconfig
config INFINIBAND_IRDMA
       tristate "Intel(R) Ethernet Connection RDMA Driver"
       depends on INET && (I40E || ICE)
       depends on IPV6 || !IPV6
       depends on PCI
       select GENERIC_ALLOCATOR
       ---help---
       This is an Ethernet RDMA driver that supports E810 (iWARP/RoCE)
       and X722 (iWARP) network devices.
       To compile this driver as a module, choose M here. The module
       will be called irdma.
```
